## CMakeLists.txt
```
cmake_minimum_required(VERSION 3.20.0)

list(APPEND EXTRA_CONF_FILE
    ${CMAKE_CURRENT_SOURCE_DIR}/secrets.conf
)


find_package(Zephyr REQUIRED HINTS $ENV{ZEPHYR_BASE})

project(neural_data_streaming)

target_sources(app PRIVATE
 src/main.c
 src/wifi.c
 src/ns_flash.c
 src/ns_test_data.c
 src/ns_data_processing.c)

 target_include_directories(app PRIVATE
    include
)
```

## prj.conf
```kconfig
# prj.conf

# Wifi config
CONFIG_WIFI=y  #Enables the general Wi-Fi drivers in the application
CONFIG_WIFI_NM_WPA_SUPPLICANT=y  #Enables WPA (Wi-Fi Protected Access) supplicant as 
                                 #the network management backend for WIFI_NM. The WPA supplicant is primarily responsible for implementing the authentication phase of WPA, as well as network scanning, key exchange and roaming support.

# Network Management API Configuration
CONFIG_NETWORKING=y
CONFIG_NET_MGMT=y    #Adds the Network Management API
CONFIG_NET_MGMT_EVENT=y  #Adds support for runtime network event notifications
CONFIG_NET_MGMT_EVENT_INFO=y   #Adds supports for passing information along with an event 
CONFIG_NET_IPV4=y
CONFIG_NET_DHCPV4=y


#Add Socket Support
CONFIG_NET_SOCKETS=y


# Connection Manager
CONFIG_NET_CONNECTION_MANAGER=y
CONFIG_NET_CONNECTION_MANAGER_MONITOR_STACK_SIZE=5200
CONFIG_L2_WIFI_CONNECTIVITY=y
CONFIG_L2_WIFI_CONNECTIVITY_AUTO_CONNECT=n


# Home Wi-Fi credentials - development only
CONFIG_WIFI_CREDENTIALS=y
CONFIG_WIFI_CREDENTIALS_STATIC=y


#Logging
CONFIG_LOG=y

#Config external flash
CONFIG_FLASH=y

#Magic number alert:
#Needed to increase main stack size to fix a stack overflow issue when calling Zephyr networking functions
#Stack size of 16384 is working fine for now, but warrants more investigation later
CONFIG_MAIN_STACK_SIZE=16384 
```

## src/main.c
```c
#include "wifi.h"
#include "ns_flash.h"
#include "ns_test_data.h"
#include "ns_data_processing.h"

#include <zephyr/kernel.h>
#include <zephyr/logging/log.h>
#include <zephyr/net/socket.h>
#include <string.h>


#define NUM_SAMPLES 512
#define RECEIVER_IP "192.168.0.19"

#define N_PACKETS       10
#define SAMPLES_PER_PKT 512
#define BYTES_PER_SAMPLE 2

#define PACKET_BYTES (SAMPLES_PER_PKT * BYTES_PER_SAMPLE)


LOG_MODULE_REGISTER(main, LOG_LEVEL_INF);


// Temporary helper function
// Want to fill flash with a large number of periods of a single sine wave

static int fill_flash_with_sine(void)
{
    int16_t buffer[NUM_SAMPLES];

    test_data_generate_sine(buffer, NUM_SAMPLES);

    size_t flash_size = ns_flash_get_size();
    size_t buffer_size = sizeof(buffer);

	// int err = ns_flash_erase(0, flash_size);
	// if(err != 0){
	// 	LOG_ERR("Error in fill_flash_with_sine() - could not erase flash memory before write.");
	// }

    for (size_t offset = 0; offset < flash_size; offset += buffer_size) {

        size_t bytes_to_write = buffer_size;

        if (offset + bytes_to_write > flash_size) {
            bytes_to_write = flash_size - offset;
        }

        int err = ns_flash_write(offset, buffer, bytes_to_write);

        if (err) {
            return err;
        }
    }

    return 0;
}


int main(void)
{

	// Step 1) Initialise and fill external flash
	int err = ns_flash_init();

	if (err) {
		LOG_ERR("Failed to initialise external flash.");
		return 0;
	}




	// err = fill_flash_with_sine();
	// 	if (err) {
	// 	LOG_ERR("fill_flash_with_sine() function failed.");	
	// 	return 0;
	// }


	// LOG_INF("fill_flash_with_sine() executed successfully");



	// Step 2) Establish wifi connection
    wifi_init();
	k_sleep(K_SECONDS(3));   //Magic number - works for now, need to replace with event driven timing

    err = wifi_connect();
    if (err) {
        LOG_ERR("main(): Wi-Fi connection request failed: %d", err);
        return err;
    }

    LOG_INF("Waiting for Wi-Fi connection...");
    wifi_wait_for_connection();    
    LOG_INF("Wi-Fi connected successfully");


	
	//Step 3) Establish connection with receiver with Zephyr socket API
	int sock = zsock_socket(AF_INET, SOCK_DGRAM, IPPROTO_UDP);

	if (sock < 0) {
		LOG_ERR("Failed to create socket");
		return sock;
	}

	struct sockaddr_in dest_addr = {0};

	dest_addr.sin_family = AF_INET;
	dest_addr.sin_port = htons(5000);

	err = zsock_inet_pton(AF_INET,
							RECEIVER_IP,
							&dest_addr.sin_addr);

	if (err != 1) {
		LOG_ERR("Invalid IP address");
		zsock_close(sock);
		return -1;
	}


	//Step 4) Read data from flash and send to receiver
	uint16_t tx_buf[PACKET_BYTES];

	for (uint32_t i = 0; i < N_PACKETS; i++) {

		uint32_t flash_offset = i * PACKET_BYTES;

		err = ns_flash_read(flash_offset,
							tx_buf,
							PACKET_BYTES);

		if (err) {
			LOG_ERR("Flash read failed at packet %u", i);
			break;
		}

		//Perform some placeholder operations on the data buffer
		ns_processing_clip(tx_buf, SAMPLES_PER_PKT, (int16_t)25000);


		ssize_t sent = zsock_sendto(sock,
									tx_buf,
									PACKET_BYTES,
									0,
									(struct sockaddr *)&dest_addr,
									sizeof(dest_addr));

		if (sent != PACKET_BYTES) {
			LOG_ERR("Packet %u did not send correct number of bytes", i);
			zsock_close(sock);
			break;
		}

		LOG_INF("Sent packet %u (%d bytes)", i, sent);
	}



	zsock_close(sock);



    return 0;
}
```

## include/ns_data_processing.h
```c
/*For our initial purposes/commit, we just want to verify that we can pass a pointer to a buffer of data and modify it some way,
and ensure that this can be integrated into the current streaming setup
-> To that end, we will implement an amplitude clipping function and verify that the data at the receiver matches our expectation
*/


#ifndef NS_DATA_PROCESSING
#define NS_DATA_PROCESSING

#include <stdint.h>
#include <stddef.h>



/**
 * @brief Apply symmetric hard clipping to a sample buffer.
 *
 * Limits the amplitude of each sample to the range
 * [-threshold, threshold]. Samples outside this range are
 * replaced with the corresponding limit.
 *
 * The operation is performed in-place, modifying the original buffer.
 *
 * @param buffer    Pointer to the sample buffer.
 * @param n_samples Number of samples in the buffer.
 * @param threshold Maximum permitted absolute sample amplitude.
 *                  Must be non-negative.
 */
void ns_processing_clip(int16_t *buffer,
                        size_t n_samples,
                        int16_t threshold);


#endif
```

## include/ns_flash.h
```c
#ifndef FLASH_H
#define FLASH_H

#include <stddef.h>
#include <stdint.h>


/**
 * @brief Initialise the external flash memory.
 *
 * Checks that the external flash device is available and ready for use.
 * This function should be called once before any read, write, or erase
 * operations are attempted.
 *
 * @return 0 on success, or a negative error code on failure.
 */
int ns_flash_init(void);


/**
 * @brief Write data to external flash memory.
 *
 * Writes @p len bytes from the memory location pointed to by @p data
 * into external flash, starting at the specified byte @p offset.
 *
 * The flash region being written to may need to be erased beforehand,
 * depending on its current contents.
 *
 * @param offset Byte offset from the beginning of external flash.
 * @param data   Pointer to the data to be written.
 * @param len    Number of bytes to write.
 *
 * @return 0 on success, or a negative error code on failure.
 */
int ns_flash_write(uint32_t offset, const void *data, size_t len);


/**
 * @brief Read data from external flash memory.
 *
 * Reads @p len bytes from external flash, starting at the specified
 * byte @p offset, and copies them into the buffer pointed to by @p buffer.
 *
 * The destination buffer must be large enough to hold @p len bytes.
 *
 * @param offset Byte offset from the beginning of external flash.
 * @param buffer Pointer to the destination buffer.
 * @param len    Number of bytes to read.
 *
 * @return 0 on success, or a negative error code on failure.
 */
int ns_flash_read(uint32_t offset, void *buffer, size_t len);


/**
 * @brief Erase a region of external flash memory.
 *
 * Erases the flash region beginning at @p offset for @p len bytes.
 *
 * Flash memory generally has erase-size alignment requirements, so
 * @p offset and @p len may need to correspond to complete erase sectors.
 *
 * After erasure, erased bytes will normally read back as 0xFF.
 *
 * @param offset Byte offset from the beginning of external flash.
 * @param len    Number of bytes to erase.
 *
 * @return 0 on success, or a negative error code on failure.
 */
int ns_flash_erase(uint32_t offset, size_t len);


#endif /* FLASH_H */



/**
 * @brief Return number of bytes in external flash memory
 * 
 * 
 * @return number of bytes
 */
size_t ns_flash_get_size(void);
```

## include/ns_test_data.h
```c
#ifndef NS_TEST_DATA_H
#define NS_TEST_DATA_H

#include <stddef.h>
#include <stdint.h>


/**
 * @brief Generate one period of a signed 16-bit sine wave.
 *
 * Fills the supplied buffer with @p n evenly spaced samples representing
 * one complete sine-wave period.
 *
 * @param buf Pointer to the destination sample buffer.
 * @param n Number of samples to generate.
 */
void test_data_generate_sine(int16_t *buf, size_t n);




#endif
```

## src/ns_data_processing.c
```c
#include "ns_data_processing.h"



void ns_processing_clip(int16_t *buffer,
                        size_t n_samples,
                        int16_t threshold)
                        {
                             for (size_t i = 0; i < n_samples; i++) {
                                if (buffer[i] > threshold) {
                                    buffer[i] = threshold;
                                }
                                else if (buffer[i] < -threshold) {
                                    buffer[i] = -threshold;
                                }

                        }

                    }
```

## src/ns_flash.c
```c
#include "ns_flash.h"

#include <errno.h>

#include <zephyr/device.h>
#include <zephyr/devicetree.h>
#include <zephyr/drivers/flash.h>
#include <zephyr/logging/log.h>


LOG_MODULE_REGISTER(ns_flash, LOG_LEVEL_INF);


/* External MX25R64 SPI-NOR flash defined by the board devicetree. */
#define FLASH_NODE DT_NODELABEL(mx25r64)

/* Zephyr device object used for all flash operations in this module. */
static const struct device *flash_dev = DEVICE_DT_GET(FLASH_NODE);


int ns_flash_init(void)
{
    if (!device_is_ready(flash_dev)) {
        LOG_ERR("External flash device is not ready");
        return -ENODEV;
    }

    LOG_INF("External flash initialised");

    return 0;
}


int ns_flash_write(uint32_t offset, const void *data, size_t len)
{
    int err = flash_write(flash_dev, offset, data, len);

    if (err) {
        LOG_ERR("Flash write failed: %d", err);
        return err;
    }

    LOG_DBG("Wrote %zu bytes at offset 0x%08x", len, offset);

    return 0;
}


int ns_flash_read(uint32_t offset, void *buffer, size_t len)
{
    int err = flash_read(flash_dev, offset, buffer, len);

    if (err) {
        LOG_ERR("Flash read failed: %d", err);
        return err;
    }

    LOG_DBG("Read %zu bytes at offset 0x%08x", len, offset);

    return 0;
}


int ns_flash_erase(uint32_t offset, size_t len)
{
    int err = flash_erase(flash_dev, offset, len);

    if (err) {
        LOG_ERR("Flash erase failed: %d", err);
        return err;
    }

    LOG_DBG("Erased %zu bytes at offset 0x%08x", len, offset);

    return 0;
}
```

## src/ns_test_data.c
```c
#include "ns_test_data.h"

#include <math.h>
#include <zephyr/logging/log.h>

#define SINE_AMPLITUDE 30000.0f
#define PI 3.14159265358979323846f

LOG_MODULE_REGISTER(ns_test_data, LOG_LEVEL_INF);

void test_data_generate_sine(int16_t *buf, size_t n)
{
    if ((buf == NULL) || (n == 0)) {
        return;
    }

    for (size_t i = 0; i < n; i++) {
        float phase = 2.0f * PI * (float)i / (float)n;

        buf[i] = (int16_t)(SINE_AMPLITUDE * sinf(phase));

        // LOG_INF("Sample %u: %d", (unsigned int)i, buf[i]);
    }
}
```

## src/wifi.c
```c
#include "wifi.h"

#include <string.h>
#include <errno.h>

#include <zephyr/kernel.h>
#include <zephyr/logging/log.h>
#include <zephyr/net/net_if.h>
#include <zephyr/net/net_mgmt.h>
#include <zephyr/net/wifi_mgmt.h>
#include <zephyr/net/wifi_credentials.h>


LOG_MODULE_REGISTER(wifi, LOG_LEVEL_INF);

// Define event mask - used to keep track of all relevant events
#define EVENT_MASK (NET_EVENT_L4_CONNECTED | NET_EVENT_L4_DISCONNECTED)


// Creating callback object for network connection
static struct net_mgmt_event_callback wifi_cb;

// Bool for keeping track of connection status
static bool connected;

// Semaphore for signalling wifi connection to main()
K_SEM_DEFINE(network_ready_sem, 0, 1);



/**
 * @brief Handle network management events.
 *
 * Called by Zephyr's network management subsystem when one of the
 * registered events in EVENT_MASK occurs.
 *
 * On NET_EVENT_L4_CONNECTED:
 * - Mark the network as connected.
 * - Signal waiting application code using network_ready_sem.
 *
 * On NET_EVENT_L4_DISCONNECTED:
 * - Mark the network as disconnected.
 * - Reset network_ready_sem.
 *
 * @param cb         Pointer to the registered network management callback.
 * @param mgmt_event Network management event that triggered the callback.
 * @param iface      Network interface associated with the event.
 */
static void net_mgmt_event_handler(
    struct net_mgmt_event_callback *cb,
    uint64_t mgmt_event,
    struct net_if *iface)
{

    ARG_UNUSED(cb);
    ARG_UNUSED(iface);

    /* Ignore events outside our event mask. */
    if ((mgmt_event & EVENT_MASK) != mgmt_event) {
        return;
    }

    if (mgmt_event == NET_EVENT_L4_CONNECTED) {
        LOG_INF("net_mgmt_event_handler(): Network connected");

        connected = true;

        /* Wake any thread waiting for network connectivity. */
        k_sem_give(&network_ready_sem);

        return;
    }

    if (mgmt_event == NET_EVENT_L4_DISCONNECTED) {
        LOG_INF("Network disconnected");

        connected = false;

        /* Network is no longer in the ready state. */
        k_sem_reset(&network_ready_sem);

        return;
    }
}


/**
 * @brief Initialize Wi-Fi event handling.
 *
 * Registers the network management callback used to monitor
 * connection and disconnection events.
 *
 * This function does not initiate a Wi-Fi connection.
 *
 * @return 0 on success.
 */
int wifi_init(void)
{
    connected = false;

    net_mgmt_init_event_callback(
        &wifi_cb,
        net_mgmt_event_handler,
        EVENT_MASK
    );

    net_mgmt_add_event_callback(&wifi_cb);

    LOG_INF("Function wifi_init(): Wi-Fi event handler initialized");

    return 0;
}




/**
 * @brief Initiate a Wi-Fi connection.
 *
 * Gets the Wi-Fi network interface, fills the connection parameters
 * such as SSID, password, security mode, channel, and band, then sends
 * a NET_REQUEST_WIFI_CONNECT request through Zephyr's Network Management API.
 *
 * This function only starts the connection attempt. Connection success
 * is reported later through the registered network event callback -> see wifi_init().
 *
 * @return 0 if the connection request was submitted successfully,
 *         otherwise a negative error code.
 */
int wifi_connect(void)
{
    struct wifi_connect_req_params params;  //wifi_connect_req_params is a Zephyr structure used for passing params to a net_mgmt() API

    struct net_if *iface = net_if_get_first_wifi();  //returns a pointer to an active wifi NW interface in Zephyr. Get Zephyr's software representation of the Wi-Fi network interface.

    if (iface == NULL) {
        LOG_ERR("Function wifi_connect() - no wifi interfaces can be found.");
        return -ENODEV;
    }

    /* Fill connection settings. */
    memset(&params, 0, sizeof(params));

    params.ssid = CONFIG_WIFI_CREDENTIALS_STATIC_SSID;
    params.ssid_length = strlen(params.ssid);

    params.psk = CONFIG_WIFI_CREDENTIALS_STATIC_PASSWORD;
    params.psk_length = strlen(params.psk);

    params.channel = WIFI_CHANNEL_ANY;
    params.security = WIFI_SECURITY_TYPE_PSK;
    params.mfp = WIFI_MFP_OPTIONAL;
    params.timeout = SYS_FOREVER_MS;
    params.band = WIFI_FREQ_BAND_UNKNOWN;

    int err =  net_mgmt(
        NET_REQUEST_WIFI_CONNECT,
        iface,
        &params,
        sizeof(params)
    );

    if(err){
        LOG_ERR("Function wifi_connect(): Connecting to Wi-Fi failed, err: %d", err);
	    return err;
    }

    return 0;

}



/**
 * @brief Wait for network 
 *
 * Registers the network management callback used to monitor
 * connection and disconnection events.
 *
 * This function does not initiate a Wi-Fi connection.
 *
 * @return 0 on success.
 */
void wifi_wait_for_connection(void){
    k_sem_take(&network_ready_sem, K_FOREVER);
}


bool wifi_is_connected(void){
    return connected;
}
```

## src/wifi.h
```c
#ifndef WIFI_H
#define WIFI_H

#include <stdbool.h>

int wifi_init(void);
int wifi_connect(void);
void wifi_wait_for_connection(void);
bool wifi_is_connected(void);

#endif
```
